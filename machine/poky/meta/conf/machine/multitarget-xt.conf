## machine/poky/meta/conf/machine/multitarget-xt.conf
```bitbake
# This is only used for multitarget bootstrap
# while xt-distro adds layers and does confivuration.
# It is suppossed that inner builds change MACHINE to what
# is appropriate.

require qemux86-64.conf
```

## machine/poky/meta/conf/machine/orangepi-4g-iot.conf
```bitbake
#@TYPE: Machine
#@NAME: Orangepi 4G-IOT Development Board
#@DESCRIPTION: Machine configuration for the Orangepi 4G-IOT

require conf/machine/include/tune-cortexa15.inc

PREFERRED_PROVIDER_virtual/kernel ?= "linux-orangepi"

MACHINEOVERRIDES = "orangepi:opi:orangepi-4g-iot:${MACHINE}"

SDIMG_KERNELIMAGE ?= "kernel.img"
SERIAL_CONSOLE ?= "921600 ttyMT0"
```

## recipes-rpi/meta-xt-rpi-common/conf/layer.conf
```bitbake
# We have a conf and classes directory, add to BBPATH
BBPATH =. "${LAYERDIR}:"

# We have recipes-* directories, add to BBFILES
BBFILES += "${LAYERDIR}/recipes-*/*/*.bb \
            ${LAYERDIR}/recipes-*/*/*.bbappend"

BBFILE_COLLECTIONS += "meta-xt-rpi-common"
BBFILE_PATTERN_meta-xt-rpi-common := "^${LAYERDIR}/"
BBFILE_PRIORITY_meta-xt-rpi-common = "6"
```

## recipes-rpi/meta-xt-rpi-common/wic/sdimage-smarthome.wks
```
# short-description: Create Raspberry Pi SD card image
# long-description: Creates a partitioned SD card image for use with
# Raspberry Pi. Boot files are located in the first vfat partition.

part /boot --source bootimg-partition --ondisk mmcblk0 --fstype=vfat --label boot --active --align 4096 --fixed-size 256M
part / --source rootfs --ondisk mmcblk0 --fstype=ext4 --label root --align 4096 --fixed-size 2G
# This is a rw overlay - could be smaller than root fs
part /overlay --ondisk mmcblk0 --fstype=ext4 --label overlay --align 4096 --fixed-size 2G
part /persist --ondisk mmcblk0 --fstype=ext4 --label data --align 4096 --fixed-size 100K
```

## recipes-vaillant/vaillant-image-initramfs/files/meta-xt-prod-extra/wic/sdimage-vaillant.wks
```
# short-description: Create Raspberry Pi SD card image
# long-description: Creates a partitioned SD card image for use with
# Raspberry Pi. Boot files are located in the first vfat partition.

part /boot --source bootimg-partition --ondisk mmcblk0 --fstype=vfat --label boot --active --align 4096 --fixed-size 256M
# The partitions below are logical
part /mnt/overlay --source rootfs --rootfs-dir=rootfs_overlay --ondisk mmcblk0 --fstype=ext4 --label overlay --align 4096 --fixed-size 1G
part /mnt/secret --source rootfs --rootfs-dir=rootfs_secret --ondisk mmcblk0 --fstype=ext4 --label secret --align 4096 --fixed-size 256M
# This *primary* partition should be resized at run-time to the disk extent
part /mnt/data --ondisk mmcblk0 --fstype=ext4 --label data --align 4096 --fixed-size 4G
```
